## drivers/iio/amplifiers/Kconfig
```kconfig
#
# Gain Amplifiers, etc.
#
# When adding new entries keep the list in alphabetical order

menu "Amplifiers"

config AD8366
	tristate "Analog Devices AD8366 VGA"
	depends on SPI
	select BITREVERSE
	help
	  Say yes here to build support for Analog Devices AD8366
	  SPI Dual-Digital Variable Gain Amplifier (VGA).

	  To compile this driver as a module, choose M here: the
	  module will be called ad8366.

config TQP4M9072
	tristate "Triquint TQP4M9072 DSA"
	depends on SPI
	help
	  Say yes here to build support for Triquint TQP4M9072
	  SPI Digital Attenuator

	  To compile this driver as a module, choose M here: the
	  module will be called tqp4m9072.

endmenu
```

## drivers/iio/switches/Kconfig
```kconfig
#
# RF switches, etc.
#
# When adding new entries keep the list in alphabetical order

menu "Switches"



config MASW010350
	tristate "Macom MASW010350 switch"
	help
	  Say yes here to build support for Macom MASW010350
	  SP4T switch

config RX1
	tristate "RX1 config"
	help
	  Say yes here to build support for RX1 rf configuration

config RX2
	tristate "RX2 config"
	help
	  Say yes here to build support for RX2 rf configuration

config RX1_DEMOD
	tristate "RX1 demodulator control"
	help
	  Say yes here to build support for RX1 demodulator config


endmenu
```

## sound/soc/adi/Kconfig
```kconfig
config SND_SOC_ADI
	tristate "Audio support for Analog Devices reference designs"
	depends on MICROBLAZE || ARCH_ZYNQ || COMPILE_TEST
	help
	  Audio support for various reference designs by Analog Devices.

config SND_SOC_ADI_AXI_I2S
	tristate "AXI-I2S support"
	depends on SND_SOC_ADI
	select SND_SOC_GENERIC_DMAENGINE_PCM
	select REGMAP_MMIO
	help
	  ASoC driver for the Analog Devices AXI-I2S softcore peripheral.

config SND_SOC_ADI_AXI_SPDIF
	tristate "AXI-SPDIF support"
	depends on SND_SOC_ADI
	select SND_SOC_GENERIC_DMAENGINE_PCM
	select REGMAP_MMIO
	help
	  ASoC driver for the Analog Devices AXI-SPDIF softcore peripheral.

config SND_SOC_ADV7511_HDMI
	tristate "ADV7511 HDMI transmitter sound support"
	depends on SND_SOC_ADI
	select SND_SOC_ADI_AXI_SPDIF

config SND_ZYBO_SOC_PCM1794A
	tristate "SoC Audio support for PCM1794A on ZYBO"
	depends on SND_SOC_ADI
	select SND_SOC_PCM1794A
	select SND_SOC_ADI_AXI_I2S
	help
	  Say Y or M if you want to add support for SoC audio on Zynq
	  ZYBO board using AXI-I2S and PCM1794A.

config SND_ZYBO_SOC_AT1201
	tristate "SoC Audio support for AT1201 on ZYBO"
	depends on SND_SOC_ADI
	select SND_SOC_AT1201
	select SND_SOC_ADI_AXI_I2S
	help
	  Say Y or M if you want to add support for SoC audio on Zynq
	  ZYBO board using AXI-I2S and AT1201.
		 
config SND_SOC_ZED_ADAU1761
	tristate "ZED board sound support"
	depends on SND_SOC_ADI
	depends on I2C
	select SND_SOC_ADI_AXI_I2S
	select SND_SOC_ADAU1761_I2C
```
